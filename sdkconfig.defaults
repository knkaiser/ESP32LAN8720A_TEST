## sdkconfig.defaults
```kconfig
# Target
CONFIG_IDF_TARGET="esp32"

# Internal EMAC with LAN8720A over RMII
CONFIG_ETH_USE_ESP32_EMAC=y
CONFIG_ETH_PHY_INTERFACE_RMII=y
CONFIG_ETH_RMII_CLK_OUTPUT=y
CONFIG_ETH_RMII_CLK_OUT_GPIO=17

# Disable SPI Ethernet (not needed)
CONFIG_ETH_USE_SPI_ETHERNET=n

# Flash size (board has 4 MB)
CONFIG_ESPTOOLPY_FLASHSIZE_4MB=y

# Log level
CONFIG_LOG_DEFAULT_LEVEL_INFO=y
CONFIG_LOG_DEFAULT_LEVEL=3
```
